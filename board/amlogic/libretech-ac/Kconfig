## board/amlogic/libretech-ac/Kconfig
```kconfig
if TARGET_LIBRETECH_AC

config SYS_BOARD
	default "libretech-ac"

config SYS_VENDOR
	default "amlogic"

config SYS_CONFIG_NAME
	default "libretech-ac"

endif
```
