// SPDX-License-Identifier: (GPL-2.0+ OR MIT)
/*
 * Copyright (c) 2019 BayLibre, SAS.
 * Author: Neil Armstrong <narmstrong@baylibre.com>
 */

#include "meson-gx-u-boot.dtsi"

&sd_emmc_c {
	status = "okay";
	pinctrl-0 = <&emmc_pins>;
};

&spifc {
	status = "enabled";
};
