// SPDX-License-Identifier: (GPL-2.0+ OR MIT)
/*
 * Copyright (c) 2023 Neil Armstrong <neil.armstrong@linaro.org>
 */

#include "meson-sm1-khadas-vim3l.dts"
#include "meson-khadas-vim3-ts050.dtsi"
#include "meson-sm1-khadas-vim3l-u-boot.dtsi"
