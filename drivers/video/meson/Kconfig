## drivers/video/meson/Kconfig
```kconfig
# SPDX-License-Identifier: GPL-2.0+
#
# Copyright (C) 2018 BayLibre, SAS
#
# Author: Neil Armstrong <narmstrong@baylibre.com>

config VIDEO_MESON
	bool "Enable Amlogic Meson video support"
	depends on VIDEO
	select DISPLAY
	select VIDEO_DW_MIPI_DSI if MESON_G12A
	select MIPI_DPHY_HELPERS if MESON_G12A
	help
	  Enable Amlogic Meson Video Processing Unit video support.
```
